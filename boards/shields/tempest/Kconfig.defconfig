## boards/shields/tempest/Kconfig.defconfig
```kconfig
if SHIELD_TEMPEST_LEFT

config ZMK_KEYBOARD_NAME
    default "TEMPEST"

config ZMK_SPLIT_BLE_ROLE_CENTRAL
    default y

config ZMK_USB
    default y

config ZMK_STUDIO
    default y

endif

if SHIELD_TEMPEST_LEFT || SHIELD_TEMPEST_RIGHT

config ZMK_SPLIT
    default y

config ZMK_BLE
	default y

endif
```

## boards/shields/tempest/Kconfig.shield
```kconfig
config SHIELD_TEMPEST_LEFT
    def_bool $(shields_list_contains,tempest_left)

config SHIELD_TEMPEST_RIGHT
    def_bool $(shields_list_contains,tempest_right)
```
